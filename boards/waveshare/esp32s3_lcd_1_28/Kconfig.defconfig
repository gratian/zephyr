## boards/waveshare/esp32s3_lcd_1_28/Kconfig.defconfig
```kconfig
# Copyright (c) 2024 Gratian Crisan
# SPDX-License-Identifier: Apache-2.0

if BOARD_ESP32S3_LCD_1_28_ESP32S3_PROCPU

config HEAP_MEM_POOL_ADD_SIZE_BOARD
	int
	default $(UINT16_MAX) if WIFI && BT
	default 51200 if WIFI
	default 40960 if BT
	default 4096

endif # BOARD_ESP32S3_LCD_1_28_ESP32S3_PROCPU

config ENTROPY_GENERATOR
	default y

config KERNEL_MEM_POOL
	default y

config PWM
	default y if DISPLAY

config LV_COLOR_16_SWAP
	default y if LVGL
```

## boards/waveshare/esp32s3_lcd_1_28/Kconfig.esp32s3_lcd_1_28
```kconfig
# Copyright (c) 2024 Gratian Crisan
# SPDX-License-Identifier: Apache-2.0

config BOARD_ESP32S3_LCD_1_28
	select SOC_ESP32S3_R2
```

## boards/waveshare/esp32s3_lcd_1_28/esp32s3_lcd_1_28_esp32s3_procpu_defconfig
```kconfig
# Copyright (c) 2024 Gratian Crisan
# SPDX-License-Identifier: Apache-2.0

CONFIG_MAIN_STACK_SIZE=2048
CONFIG_GPIO=y
CONFIG_REGULATOR=y
CONFIG_CONSOLE=y
CONFIG_SERIAL=y
CONFIG_UART_CONSOLE=y
CONFIG_CLOCK_CONTROL=y
```

## boards/waveshare/esp32s3_touch_lcd_1_46/Kconfig.esp32s3_touch_lcd_1_46
```kconfig
# Copyright (c) 2025 Gratian Crisan
# SPDX-License-Identifier: Apache-2.0

config BOARD_ESP32S3_TOUCH_LCD_1_46
	select SOC_ESP32S3_R8
	select SOC_ESP32S3_PROCPU if BOARD_ESP32S3_TOUCH_LCD_1_28_ESP32S3_PROCPU
	select SOC_ESP32S3_APPCPU if BOARD_ESP32S3_TOUCH_LCD_1_28_ESP32S3_APPCPU
```

## boards/waveshare/esp32s3_touch_lcd_1_46/board.yml
```yaml
board:
  name: esp32s3_touch_lcd_1_46
  full_name: ESP32-S3-Touch-LCD-1.46
  vendor: waveshare
  socs:
  - name: esp32s3
```

## boards/waveshare/esp32s3_touch_lcd_1_46/esp32s3_touch_lcd_1_46_esp32s3_procpu_defconfig
```kconfig
# Copyright (c) 2025 Gratian Crisan
# SPDX-License-Identifier: Apache-2.0

CONFIG_GPIO=y
CONFIG_REGULATOR=y
CONFIG_CONSOLE=y
CONFIG_SERIAL=y
CONFIG_UART_CONSOLE=y
CONFIG_CLOCK_CONTROL=y
CONFIG_INPUT=y
```

## drivers/display/Kconfig.spd2010
```kconfig
# Copyright (c) 2025 Gratian Crisan
# SPDX-License-Identifier: Apache-2.0

menuconfig SPD2010
	   bool "SPD2010 display driver"
	   default y
	   depends on DT_HAS_SOLOMON_SPD2010_ENABLED
	   select SPI
	   select SPI_EXTENDED_MODES
	   help
	     Enable driver for Solomon Systech SPD2010 (L-WEA2010)
```

## drivers/input/Kconfig.spd2010
```kconfig
# Copyright (c) 2026 Gratian Crisan
# SPDX-License-Identifier: Apache-2.0

menuconfig INPUT_SPD2010
	bool "Solomon SPD2010 capacitive touch panel driver"
	default y
	depends on DT_HAS_SOLOMON_SPD2010_TOUCH_ENABLED
	select I2C
	select INPUT_TOUCH
	help
	  Enable driver for the Solomon SPD2010 capacitive touchscreen
	  controller.

if INPUT_SPD2010

config INPUT_SPD2010_MAX_TOUCH_POINTS
	int "Maximum number of touch points"
	range 1 10
	default 5
	help
	  Maximum number of touch points to report.

config INPUT_SPD2010_INIT_DELAY_MS
	int "Initialization delay"
	depends on !INPUT_SPD2010_INTERRUPT
	default 50
	help
	  Delay in milliseconds before starting polling mode.

config INPUT_SPD2010_PERIOD_MS
	int "Sample period"
	depends on !INPUT_SPD2010_INTERRUPT
	default 20
	help
	  Polling interval in milliseconds when interrupt mode is disabled.

config INPUT_SPD2010_INTERRUPT
	bool "Interrupt"
	depends on GPIO
	default y if $(dt_compat_any_has_prop,$(DT_COMPAT_SOLOMON_SPD2010_TOUCH),irq_gpios)
	help
	  Enable interrupt support (requires irq-gpios in devicetree).

endif # INPUT_SPD2010
```

## dts/bindings/display/solomon,spd2010.yaml
```yaml
# Copyright (c) 2025 Gratian Crisan
# SPDX-License-Identifier: Apache-2.0

include: [spi-device.yaml, display-controller.yaml, lcd-controller.yaml]

title: Solomon Systech SPD2020 display controller

description: |
    The Solomon Systech SPD2010 also known as L-WEA2010 is a 24bit
    color display driver IC which supports LCD pannels with a maximum
    454x454 resolution.

compatible: "solomon,spd2010"

properties:
  reset-gpios:
    type: phandle-array
    description: RESET pin.

      The RESET pin of SPD2010 is active low.
      If connected directly the MCU pin should be configured
      as active low.
```

## dts/bindings/input/solomon,spd2010-touch.yaml
```yaml
# Copyright (c) 2026 Gratian Crisan
# SPDX-License-Identifier: Apache-2.0

description: Solomon SPD2010 capacitive touch controller

compatible: "solomon,spd2010-touch"

include: [i2c-device.yaml, touchscreen-common.yaml]

properties:
  irq-gpios:
    type: phandle-array
    description: |
      Interrupt GPIO used by the controller to indicate that data is ready.
      Signal is active low.

  rst-gpios:
    type: phandle-array
    description: |
      Reset GPIO for the controller. Signal is active low.
```
