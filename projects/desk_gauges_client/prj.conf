## prj.conf
```kconfig
CONFIG_STDOUT_CONSOLE=y
CONFIG_LOG=y
# CONFIG_UART_SAM0 is not set
CONFIG_SERIAL=y
CONFIG_UART_INTERRUPT_DRIVEN=y
CONFIG_UART_LINE_CTRL=y

CONFIG_USB=y
CONFIG_USB_DEVICE_STACK=y
CONFIG_USB_COMPOSITE_DEVICE=y
CONFIG_USB_CDC_ACM=y
CONFIG_USB_CDC_ACM_DEVICE_COUNT=1
CONFIG_USB_CDC_ACM_RINGBUF_SIZE=512

CONFIG_USB_DEVICE_HID=y
CONFIG_USB_HID_DEVICE_COUNT=1
CONFIG_USB_HID_BOOT_PROTOCOL=y
CONFIG_ENABLE_HID_INT_OUT_EP=y

CONFIG_USB_DEVICE_VID=0x239A
CONFIG_USB_DEVICE_PID=0x0010
CONFIG_USB_DEVICE_MANUFACTURER="GeckoHouse"
CONFIG_USB_DEVICE_PRODUCT="USB Dial Gauge Box"

CONFIG_USB_DEVICE_LOG_LEVEL_ERR=y
CONFIG_USB_DRIVER_LOG_LEVEL_ERR=y

CONFIG_SOC_SERIES_SAMD21=y
CONFIG_SOC_PART_NUMBER_SAMD21E18A=y
CONFIG_UART_CONSOLE_ON_DEV_NAME="CDC_ACM_0"
CONFIG_CONSOLE=y
CONFIG_CONSOLE_HANDLER=y
CONFIG_UART_CONSOLE_INIT_PRIORITY=60
CONFIG_USB_UART_CONSOLE=y

CONFIG_PINMUX=y

CONFIG_PWM=y

CONFIG_BOOTLOADER_BOSSA=y
CONFIG_BOOTLOADER_BOSSA_ADAFRUIT_UF2=y
```

## src/main.c
```c
/*
 * Copyright (c) 2021 Gratian Crisan.
 * SPDX-License-Identifier: Apache-2.0
 */

#include <zephyr.h>
#include <stdio.h>
#include <string.h>
#include <device.h>
#include <drivers/uart.h>

#include <usb/usb_device.h>
#include <usb/class/usb_hid.h>

#include <logging/log.h>

#include "pwm_dac.h"

#define DEBUG 0

#if DEBUG
LOG_MODULE_REGISTER(cdc_acm_composite, LOG_LEVEL_INF);
#else
LOG_MODULE_REGISTER(cdc_acm_composite, LOG_LEVEL_WRN);
#endif

#define HID_DATA_SZ 31
uint8_t hid_data[HID_DATA_SZ + 1];
#define REPORT_ID_1 0x01

static struct k_work hid_data_received;

/*
 * Simple HID Report Descriptor
 * Report ID is present for completeness, although it can be omitted.
 * Output of "usbhid-dump -d 2fe3:0006 -e descriptor":
 *  05 01 09 00 A1 01 15 00    26 FF 00 85 01 75 08 95
 *  01 09 00 81 02 C0
 */
static const uint8_t hid_report_desc[] = {
	HID_USAGE_PAGE(HID_USAGE_GEN_DESKTOP),
	HID_USAGE(HID_USAGE_GEN_DESKTOP_UNDEFINED),
	HID_COLLECTION(HID_COLLECTION_APPLICATION),
	HID_LOGICAL_MIN8(0x00),
	HID_LOGICAL_MAX16(0xFF, 0x00),
	HID_REPORT_ID(REPORT_ID_1),
	HID_REPORT_SIZE(8),
	HID_REPORT_COUNT(1),
	HID_USAGE(HID_USAGE_GEN_DESKTOP_UNDEFINED),
	HID_INPUT(0x02),
	HID_OUTPUT(0x02),
	HID_END_COLLECTION,
};

#if DEBUG
static void int_in_ready_cb(const struct device *dev)
{
	LOG_INF("int_in_ready_cb\n");
}

static void int_out_ready_cb(const struct device *dev)
{
	LOG_INF("int_out_ready_cb\n");
	k_work_submit(&hid_data_received);
}

static void on_idle_cb(const struct device *dev, uint16_t report_id)
{
	LOG_INF("on_idle_cb\n");
}


static void protocol_cb(const struct device *dev, uint8_t protocol)
{
	LOG_INF("New protocol: %s", protocol == HID_PROTOCOL_BOOT ?
		"boot" : "report");
}

static const struct hid_ops ops = {
	.int_in_ready = int_in_ready_cb,
	.int_out_ready = int_out_ready_cb,
	.on_idle = on_idle_cb,
	.protocol_change = protocol_cb,
};
#else
static void int_out_ready_cb(const struct device *dev)
{
	k_work_submit(&hid_data_received);
}

static const struct hid_ops ops = {
	.int_out_ready = int_out_ready_cb,
};
#endif

static const struct device* hid0_dev;
static const struct device* dev0;

static void hid_data_read(struct k_work *work)
{
	int ret;
	uint32_t len = 0;

	ret = hid_int_ep_read(hid0_dev, hid_data, HID_DATA_SZ, &len);
	if (!ret)
		pwm_dac_out(hid_data, len);
}

void main(void)
{
	uint32_t dtr = 0U;
	int ret;

	k_work_init(&hid_data_received, hid_data_read);

	hid0_dev = device_get_binding("HID_0");
	if (hid0_dev == NULL) {
		LOG_ERR("Cannot get USB HID 0 Device");
		return;
	}

	usb_hid_register_device(hid0_dev, hid_report_desc, sizeof(hid_report_desc),
				&ops);

	if (usb_hid_set_proto_code(hid0_dev, HID_BOOT_IFACE_CODE_NONE)) {
		LOG_WRN("Failed to set Protocol Code");
	}

	if (usb_hid_init(hid0_dev)) {
		LOG_ERR("Failed usb_hid_init");
	}

	dev0 = device_get_binding("CDC_ACM_0");
	if (!dev0) {
		LOG_WRN("CDC_ACM_0 device not found");
		return;
	}

	ret = usb_enable(NULL);
	if (ret != 0) {
		LOG_ERR("Failed to enable USB");
		return;
	}

	LOG_INF("Init PWM channels");
	pwm_dac_init();


	LOG_INF("Wait for DTR");

	while (1) {
		uart_line_ctrl_get(dev0, UART_LINE_CTRL_DTR, &dtr);
		if (dtr) {
			break;
		}

		k_sleep(K_MSEC(100));
	}

	printk("*** Desk Gauges Client ***\n");
	while (1) {
		k_sleep(K_MSEC(1000));
	}
}
```

## src/pwm_dac.c
```c
/*
 * Copyright (c) 2021 Gratian Crisan
 * SPDX-License-Identifier: Apache-2.0
 */

#include <zephyr.h>
#include <device.h>
#include <drivers/pwm.h>

#include <logging/log.h>

#include "pwm_dac.h"

/* Digital #0 */
#define PWM_IO0_NODE	DT_ALIAS(pwm_io0)

#if DT_NODE_HAS_STATUS(PWM_IO0_NODE, okay)
#define PWM0_CTLR	DT_PWMS_CTLR(PWM_IO0_NODE)
#define PWM0_CHANNEL	DT_PWMS_CHANNEL(PWM_IO0_NODE)
#define PWM0_FLAGS	DT_PWMS_FLAGS(PWM_IO0_NODE)
#else
#error "Unsupported board: pwm-io0 devicetree alias is not defined"
#define PWM0_CTLR	DT_INVALID_NODE
#define PWM0_CHANNEL	0
#define PWM0_FLAGS	0
#endif

/* Digital #2 */
#define PWM_IO1_NODE	DT_ALIAS(pwm_io1)

#if DT_NODE_HAS_STATUS(PWM_IO1_NODE, okay)
#define PWM1_CTLR	DT_PWMS_CTLR(PWM_IO1_NODE)
#define PWM1_CHANNEL	DT_PWMS_CHANNEL(PWM_IO1_NODE)
#define PWM1_FLAGS	DT_PWMS_FLAGS(PWM_IO1_NODE)
#else
#error "Unsupported board: pwm-io1 devicetree alias is not defined"
#define PWM1_CTLR	DT_INVALID_NODE
#define PWM1_CHANNEL	0
#define PWM1_FLAGS	0
#endif

/* Digital #4 */
#define PWM_IO2_NODE	DT_ALIAS(pwm_io2)

#if DT_NODE_HAS_STATUS(PWM_IO2_NODE, okay)
#define PWM2_CTLR	DT_PWMS_CTLR(PWM_IO2_NODE)
#define PWM2_CHANNEL	DT_PWMS_CHANNEL(PWM_IO2_NODE)
#define PWM2_FLAGS	DT_PWMS_FLAGS(PWM_IO2_NODE)
#else
#error "Unsupported board: pwm-io2 devicetree alias is not defined"
#define PWM2_CTLR	DT_INVALID_NODE
#define PWM2_CHANNEL	0
#define PWM2_FLAGS	0
#endif

/* Digital #3 */
#define PWM_IO3_NODE	DT_ALIAS(pwm_io3)

#if DT_NODE_HAS_STATUS(PWM_IO3_NODE, okay)
#define PWM3_CTLR	DT_PWMS_CTLR(PWM_IO3_NODE)
#define PWM3_CHANNEL	DT_PWMS_CHANNEL(PWM_IO3_NODE)
#define PWM3_FLAGS	DT_PWMS_FLAGS(PWM_IO3_NODE)
#else
#error "Unsupported board: pwm-io3 devicetree alias is not defined"
#define PWM3_CTLR	DT_INVALID_NODE
#define PWM3_CHANNEL	0
#define PWM3_FLAGS	0
#endif

/* LED #0 */
#define PWM_LED0_NODE	DT_ALIAS(pwm_led0)

#if DT_NODE_HAS_STATUS(PWM_LED0_NODE, okay)
#define LED0_CTLR	DT_PWMS_CTLR(PWM_LED0_NODE)
#define LED0_CHANNEL	DT_PWMS_CHANNEL(PWM_LED0_NODE)
#define LED0_FLAGS	DT_PWMS_FLAGS(PWM_LED0_NODE)
#else
#error "Unsupported board: pwm_led0 devicetree alias is not defined"
#define LED0_CTLR	DT_INVALID_NODE
#define LED0_CHANNEL	0
#define LED0_FLAGS	0
#endif

#define PWM_DAC_PERIOD	120

struct pwm_dac_channel {
	const struct device* dev;
	int (*out)(uint8_t);
};

static int pwm_dac_out_ch0(uint8_t val);
static int pwm_dac_out_ch1(uint8_t val);
static int pwm_dac_out_ch2(uint8_t val);
static int pwm_dac_out_ch3(uint8_t val);
static int pwm_dac_out_led0(uint8_t val);

static const struct pwm_dac_channel dac_ch[] = {
	{.dev = DEVICE_DT_GET(PWM0_CTLR), .out = pwm_dac_out_ch0},
	{.dev = DEVICE_DT_GET(PWM1_CTLR), .out = pwm_dac_out_ch1},
	{.dev = DEVICE_DT_GET(PWM2_CTLR), .out = pwm_dac_out_ch2},
	{.dev = DEVICE_DT_GET(PWM3_CTLR), .out = pwm_dac_out_ch3},
	{.dev = DEVICE_DT_GET(LED0_CTLR), .out = pwm_dac_out_led0},
};

static int pwm_dac_out_ch0(uint8_t val)
{
	if (val > PWM_DAC_PERIOD)
		val = PWM_DAC_PERIOD;

	return pwm_pin_set_cycles(dac_ch[0].dev, PWM0_CHANNEL,
				PWM_DAC_PERIOD, val, PWM0_FLAGS);
}

static int pwm_dac_out_ch1(uint8_t val)
{
	if (val > PWM_DAC_PERIOD)
		val = PWM_DAC_PERIOD;

	return pwm_pin_set_cycles(dac_ch[1].dev, PWM1_CHANNEL,
				PWM_DAC_PERIOD, val, PWM1_FLAGS);
}

static int pwm_dac_out_ch2(uint8_t val)
{
	if (val > PWM_DAC_PERIOD)
		val = PWM_DAC_PERIOD;

	return pwm_pin_set_cycles(dac_ch[2].dev, PWM2_CHANNEL,
				PWM_DAC_PERIOD, val, PWM2_FLAGS);
}

static int pwm_dac_out_ch3(uint8_t val)
{
	if (val > PWM_DAC_PERIOD)
		val = PWM_DAC_PERIOD;

	return pwm_pin_set_cycles(dac_ch[3].dev, PWM3_CHANNEL,
				PWM_DAC_PERIOD, val, PWM3_FLAGS);
}

static int pwm_dac_out_led0(uint8_t val)
{
	if (val > PWM_DAC_PERIOD)
		val = PWM_DAC_PERIOD;

	return pwm_pin_set_cycles(dac_ch[4].dev, LED0_CHANNEL,
				PWM_DAC_PERIOD, val, LED0_FLAGS);
}

int pwm_dac_out_ch(uint8_t ch, uint8_t val)
{
	int ret;

	if (ch >= sizeof(dac_ch)/sizeof(struct pwm_dac_channel))
		return -EINVAL;

	ret = dac_ch[ch].out(val);

	return ret;
}

int pwm_dac_out(uint8_t *data, uint32_t cnt)
{
	uint32_t i;
	int ret;

	for (i = 0, ret = 0; i < cnt && i < sizeof(dac_ch)/sizeof(struct pwm_dac_channel); i++)
		ret += pwm_dac_out_ch(i, data[i]);

	return ret;
}

/* work-around for pwm glitch on first update */
#define PWM_INIT_RETRIES 2

int pwm_dac_init()
{
	uint8_t i, j;
	int ret;

	for (j = 0; j < PWM_INIT_RETRIES; j++) {
		for (i = 0, ret = 0; i < sizeof(dac_ch)/sizeof(struct pwm_dac_channel); i++)
			ret += pwm_dac_out_ch(i, 0);
		k_sleep(K_MSEC(100));
	}

	return ret;
}
```

## src/pwm_dac.h
```c
/*
 * Copyright (c) 2021 Gratian Crisan
 * SPDX-License-Identifier: Apache-2.0
 */

#ifndef PWM_DAC_H
#define PWM_DAC_H

int pwm_dac_init();
int pwm_dac_out_ch(uint8_t ch, uint8_t val);
int pwm_dac_out(uint8_t *data, uint32_t cnt);

#endif /* PWM_DAC_H */
```
